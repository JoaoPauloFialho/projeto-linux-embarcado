/dts-v1/;
/plugin/;

/ {
    compatible = "ti,beaglebone", "ti,beaglebone-black";

    /* Identificação do metadado do overlay */
    part-number = "bb-w1-p822";
    version = "00A0";

    /* Fragmento 1: Configuração do Pinmuxing */
    fragment@0 {
        target = <&am33xx_pinmux>;
        __overlay__ {
            w1_pins: pinmux_w1_pins {
                pinctrl-single,pins = <
                    0x02c 0x37 /* P8_22: RX Ativo | Pull-Up Interno | Modo 7 (GPIO) */
                >;
            };
        };
    };

    /* Fragmento 2: Instanciação do driver w1-gpio */
    fragment@1 {
        target-path = "/";
        __overlay__ {
            onewire {
                compatible = "w1-gpio";
                pinctrl-names = "default";
                pinctrl-0 = <&w1_pins>;
                
                /* Mapeamento: Banco GPIO 1, Linha 5, Flag 0 (Active High) */
                gpios = <&gpio1 5 0>; 
                
                status = "okay";
            };
        };
    };
};